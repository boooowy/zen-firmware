#include "zen.dtsi"
#include <input/processors.dtsi>
#include <dt-bindings/zmk/input_transform.h>

/* タイピング直後の誤接触でマウスレイヤー(1)に入らないようにする */
&zip_delay_temp_layer {
    require-prior-idle-ms = <200>;
};

&pointing_listener {
    input-processors =
        <&zip_xy_transform (INPUT_TRANSFORM_X_INVERT | INPUT_TRANSFORM_Y_INVERT)>,
        <&zip_delay_temp_layer 1 300>;

    scroller {
        layers = <4>;
        input-processors =
            <&zip_xy_transform (INPUT_TRANSFORM_Y_INVERT)>,
            <&zip_xy_to_scroll_mapper>,
            <&scroll_scaler 1 28>;
        process-next;
    };
};

&zen_transform {
    col-offset = <7>;
};
