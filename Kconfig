## Kconfig
```kconfig
# Sensor data simulator
#
# Copyright (c) 2019 Nordic Semiconductor
#
# SPDX-License-Identifier: LicenseRef-Nordic-5-Clause
#

config ZEN_LCD_STATUS_SCREEN
  bool "ZEN LS011B7DH03 custom status screen"
  depends on ZMK_DISPLAY
  help
    Show the ZEN boot logo and keyboard status dashboard on the left Central LCD.

config ZEN_LCD_DOT_STATUS
  bool "Use the experimental ZEN dot font on the status dashboard"
  depends on ZEN_LCD_STATUS_SCREEN
  help
    Render the four-line status dashboard with the compact original ZEN dot font.

menuconfig PMW3610_ALT
  bool "PMW3610 mouse optical sensor"
  select SPI
  depends on INPUT
  depends on DT_HAS_PIXART_PMW3610_ALT_ENABLED
  help
      Enable PMW3610 mouse optical sensor.

if PMW3610_ALT

config INPUT_PMW3610_INIT_PRIORITY
    int "PMW3610 initialization priority"
    default INPUT_INIT_PRIORITY

config PMW3610_ALT_SWAP_XY
  bool "Swap the X/Y axis of PMW3610 sensor"

config PMW3610_ALT_INVERT_X
  bool "Invert the X axis of PMW3610 sensor"

config PMW3610_ALT_INVERT_Y
  bool "Invert the Y axis of PMW3610 sensor"

config PMW3610_ALT_INIT_POWER_UP_EXTRA_DELAY_MS
  int "Extra power up init delay (ms)"
  default 0
  help
    Default minimum init power up delay is 10ms.
    Use this config to postpone init power up sequence if needs longer bootup time.

config PMW3610_ALT_INIT_RETRY_DELAY_MS
  int "PMW3610 init retry delay (ms)"
  default 1000
  help
    Delay before restarting the PMW3610 async init sequence after an init failure.

config PMW3610_ALT_INIT_RETRY_MAX_ATTEMPTS
  int "PMW3610 init retry max attempts"
  default 0
  help
    Maximum number of full init attempts after failures. 0 means retry indefinitely.

config PMW3610_ALT_REPORT_INTERVAL_MIN
	int "PMW3610's default minimum report rate"
	default 0
	help
	  Default minimum report interval in milliseconds.
		Slow down input reporting for hid queue over the air.
		Turn value down to 8ms to get sharp response if use with USB only.

config PMW3610_ALT_SMART_ALGORITHM
  bool "Enable an algorithm of PMW3610 to enhance surface coverage"
  default y
  help
    Enable the integration of the smart algorithm as the datasheet implementation.
    The algorithm is used to extend the tracking acrocss a wider range of surfaces
    such as graniles and tiles.

config PMW3610_ALT_RUN_DOWNSHIFT_TIME_MS
    int "PMW3610's default RUN mode downshift time"
    default 128
    range 13 3264
    help
      Default RUN mode downshift down time in milliseconds.
      Time after which sensor goes from RUN to REST1 mode.

config PMW3610_ALT_REST1_DOWNSHIFT_TIME_MS
    int "PMW3610's default REST1 mode downshift time"
    default 5000
    help
      Default REST1 mode downshift down time in milliseconds.
      Time after which sensor goes from REST1 to REST2 mode.

config PMW3610_ALT_REST2_DOWNSHIFT_TIME_MS
    int "PMW3610's default REST2 mode downshift time"
    default 17000
    help
      Default REST2 mode downshift down time in milliseconds.
      Time after which sensor goes from REST2 to REST3 mode.

config PMW3610_ALT_REST1_SAMPLE_TIME_MS
    int "PMW3610's sample time in REST1 stage"
    default 40
    # range 10 2550
    help
      Default REST1 mode sample period in millisecond

config PMW3610_ALT_REST2_SAMPLE_TIME_MS
    int "PMW3610's sample time in REST2 stage"
    default 100
    # range 10 2550
    help
      Default REST2 mode sample period in millisecond.

config PMW3610_ALT_REST3_SAMPLE_TIME_MS
    int "PMW3610's sample time in REST3 stage"
    default 500
    # range 10 2550
    help
      Default REST2 mode sample period in millisecond.

module = PMW3610_ALT
module-str = PMW3610_ALT
source "${ZEPHYR_BASE}/subsys/logging/Kconfig.template.log_config"

endif #PMW3610_ALT

menuconfig IQS7211E
    bool "IQS7211E capcacitive touch sensor"
    select I2C
    help
      Enable IQS7211E capcacitive touch sensor.

if IQS7211E

config IQS7211E_TAP_EDGE_MARGIN_PERMILLE
    int "Tap ignore edge margin (permille)"
    range 0 450
    default 80
    help
      Edge margin used to suppress tap/click detection in scroller mode.
      80 means 8 percent margin from each edge.

config IQS7211E_SCROLLER_HWHEEL_ZONE_MIN_PERMILLE
    int "HWheel zone start (permille)"
    range 0 1000
    default 0
    help
      Start position of the horizontal scroll zone in permille of Y size.
      This value and MAX define a band [MIN, MAX).

config IQS7211E_SCROLLER_HWHEEL_ZONE_MAX_PERMILLE
    int "HWheel zone end (permille)"
    range 0 1000
    default 150
    help
      End position of the horizontal scroll zone in permille of Y size.
      This value and MIN define a band [MIN, MAX).

config IQS7211E_TWO_FINGER_SCROLL_DIVIDER
    int "Two-finger scroll delta divider"
    range 1 64
    default 8
    help
      Scales down the default two-finger scroll path without affecting
      one-finger pointer movement. Higher values make scroll slower.

config IQS7211E_TAP_SUPPRESS_DISTANCE
    int "Tap suppress distance after scroll gesture"
    range 1 512
    default 24
    help
      Raw two-finger movement distance required before tap recognition is
      suppressed until all fingers are released. Higher values make tap
      recognition more permissive during small scroll gestures.

config IQS7211E_TWO_FINGER_SCROLL_JUMP_THRESHOLD
    int "Two-finger scroll jump threshold"
    range 1 2048
    default 180
    help
      Ignore a two-finger scroll sample when either axis delta exceeds this
      raw threshold. This helps suppress release-time coordinate jumps that
      can produce one large unintended scroll event.

config IQS7211E_SCROLLER_INERTIA
    bool "Enable inertia scrolling in scroller mode"
    default n
    help
      Keep sending wheel events after finger release when the device is in
      scroller mode. Uses fixed-point integer math (no FPU required).

config IQS7211E_SCROLLER_INERTIA_DECAY_PERMILLE
    int "Inertia decay coefficient (permille)"
    range 1 999
    default 920
    depends on IQS7211E_SCROLLER_INERTIA
    help
      Velocity multiplier applied every 10ms tick.
      920 means velocity = velocity * 0.92 per tick.

config IQS7211E_SCROLLER_INERTIA_STOP_THRESHOLD_Q8
    int "Inertia stop threshold (Q8 wheel units per 10ms)"
    range 1 4096
    default 96
    depends on IQS7211E_SCROLLER_INERTIA
    help
      Inertia stops immediately when absolute velocity goes below this value.
      Q8 means 256 equals 1 wheel unit per 10ms.

endif

config ZMK_INPUT_PROCESSOR_DELAY_TEMP_LAYER
    bool "Delayed temporary layer input processor"
    default y
    depends on ZMK_POINTING
    depends on !ZMK_SPLIT || ZMK_SPLIT_ROLE_CENTRAL
    depends on DT_HAS_ZMK_INPUT_PROCESSOR_DELAY_TEMP_LAYER_ENABLED
    help
      Temp layer input processor that only activates the layer after the pointing
      device has been moving for a configurable amount of time/distance.

config ZMK_INPUT_PROCESSOR_DELAY_TEMP_LAYER_MAX_ACTION_EVENTS
    int "Delayed Temporary Layer Input Processor Max Action Events"
    default 4
    depends on ZMK_INPUT_PROCESSOR_DELAY_TEMP_LAYER

menuconfig ZEN_TELEMETRY
    bool "ZEN telemetry stream for companion apps"
    default n
    depends on !ZMK_SPLIT || ZMK_SPLIT_ROLE_CENTRAL
    help
      Publish live keyboard state (active layers, key positions, keycodes,
      modifiers, battery, endpoint) so a companion app such as zen-hud can show
      an on-screen overlay. Central only: the peripheral has no host to talk to.

      The wire format is documented in docs/zen-telemetry-protocol.md.

if ZEN_TELEMETRY

config ZEN_TELEMETRY_BLE
    bool "Carry ZEN telemetry over a custom BLE GATT service"
    default y
    depends on ZMK_BLE
    # Reads each host's GAP Device Name, so the companion app can say which
    # machine sits on which BLE profile.
    select BT_GATT_CLIENT
    help
      Adds a notify-only GATT service alongside HID, so the companion app needs
      no cable and no input monitoring permission.

config ZEN_TELEMETRY_RING_SIZE
    int "Telemetry ring buffer size (bytes)"
    default 512
    help
      Buffers event records between the ZMK listeners and the sending work
      queue. When it fills, the oldest records are dropped and a full state
      snapshot is queued instead.

config ZEN_TELEMETRY_STACK_SIZE
    int "Telemetry work queue stack size (bytes)"
    default 2048
    help
      The queue notifies every subscribed host, reads host names over GATT and
      writes them to flash. An overflow here would fault the whole keyboard,
      not just telemetry, so this is sized with room to spare.

config ZEN_TELEMETRY_THREAD_PRIORITY
    int "Telemetry work queue thread priority"
    default 10
    help
      Must stay a low preemptible priority so telemetry never delays HID
      reports, split reception, or the system work queue.

config ZEN_TELEMETRY_RETRY_MS
    int "Delay before retrying a failed telemetry send (ms)"
    default 20

module = ZEN_TELEMETRY
module-str = ZEN_TELEMETRY
source "${ZEPHYR_BASE}/subsys/logging/Kconfig.template.log_config"

endif # ZEN_TELEMETRY

config ZEN_CONFIG_BRIDGE
    bool "ZEN Configurator serial bridge"
    default y
    depends on ZMK_USB
    depends on !ZMK_STUDIO
    help
      The USB serial endpoint the ZEN Configurator talks to: pointer
      settings, the keymap, status and Bluetooth profiles.

      It cannot run alongside ZMK Studio. Both listen on the UART that
      `zmk,studio-rpc-uart` names, and two threads polling the same port
      take each other's bytes, so neither answers reliably. That is why
      this depends on !ZMK_STUDIO rather than merely warning about it:
      turning Studio on in a shield .conf is enough to turn the bridge
      off, and the build is coherent either way.

      Only where ZMK owns the USB stack. On a split peripheral
      CONFIG_ZMK_USB is off, the CDC-ACM port exists but nothing manages
      it, and polling it there stops the half waking from deep sleep.

config ZEN_RUNTIME_COMBO
    bool "Editable combo slots"
    default y
    depends on ZEN_CONFIG_BRIDGE
    help
      Adds combo slots that can be rewritten while the keyboard is running,
      so combos no longer require a fork and a GitHub Actions build.

      Only where the Configurator bridge runs, which is the split central;
      a peripheral has no combo matcher of its own to feed.

      Requires a `combos` node in the keymap. ZMK compiles the whole combo
      subsystem out when there are none, and this cannot bring it back --
      config/keymap.keymap declares one, which is what keeps it in.

      Turning this off restores the stock behaviour exactly: app/src/combo.c
      then preprocesses to what it was before the ZEN patch, const array
      included.

if ZEN_RUNTIME_COMBO

config ZEN_RUNTIME_COMBO_SLOTS
    int "Editable combo slots"
    range 1 32
    default 8
    help
      Slots on top of the combos the keymap declares. Those stay read-only.

config ZEN_RUNTIME_COMBO_MAX_KEYS
    int "Maximum keys in an editable combo"
    range 2 8
    default 4
    help
      ZMK sizes its combo arrays from the longest combo in the keymap, so a
      keymap holding only 2-key combos could otherwise never gain a 3-key
      one. This raises that floor, at the cost of a larger combo table.

endif

config ZEN_RUNTIME_MACRO
    bool "Editable macro slots"
    default y
    depends on ZEN_CONFIG_BRIDGE
    help
      Adds macro slots that can be rewritten while the keyboard is running.
      A slot is played by the zen,behavior-macro behavior, whose parameter is
      the slot number, so a runtime combo can trigger one without touching
      the keymap.

      The behavior node is declared in zen.dtsi. With this off the driver is
      not compiled and the node simply instantiates nothing, which is how a
      split peripheral builds.

      Playback goes through ZMK's own behavior queue, which copies each step
      as it is queued -- so editing a slot mid-playback cannot derail one
      that is already running.

if ZEN_RUNTIME_MACRO

config ZEN_RUNTIME_MACRO_SLOTS
    int "Editable macro slots"
    range 1 8
    default 4

config ZEN_RUNTIME_MACRO_STEPS
    int "Maximum steps in one macro"
    range 2 32
    default 16
    help
      Each step costs 8 bytes per slot, and playing one costs up to two
      entries in ZMK's behavior queue (CONFIG_ZMK_BEHAVIORS_QUEUE_SIZE).

endif
```

## dts/bindings/behaviors/zen,behavior-macro.yaml
```yaml
# Copyright (c) 2026 E24-GH
# SPDX-License-Identifier: MIT

description: |
  A macro whose steps can be rewritten while the keyboard is running.

  Unlike zmk,behavior-macro, which compiles its bindings in from devicetree,
  this one reads them from a slot the config bridge can write. The parameter
  is the slot number.

compatible: "zen,behavior-macro"

include: one_param.yaml
```

## dts/bindings/input_processors/zen,input-processor-auto-mouse.yaml
```yaml
# SPDX-License-Identifier: GPL-2.0-or-later

description: |
  Input processor that holds a layer on while the pointing device is moving.

  Same idea as zmk,input-processor-temp-layer, but the on/off switch, the
  timeout and the "do not switch layers this soon after a keystroke" guard are
  read from zen_pointer_settings on every event instead of being fixed in
  devicetree, so the Configurator can change them on a running keyboard.

  Which layer to hold is NOT runtime-adjustable -- it is a property of how the
  keymap is laid out, not a preference -- so it stays here.

compatible: "zen,input-processor-auto-mouse"

include: ip_zero_param.yaml

properties:
  layer:
    type: int
    required: true
    description: Index of the layer to hold on while the pointer is moving.
```

## dts/bindings/input_processors/zen,input-processor-live-scale.yaml
```yaml
# SPDX-License-Identifier: GPL-2.0-or-later

description: |
  Input processor that scales/inverts REL_X, REL_Y, REL_WHEEL and REL_HWHEEL
  events using a runtime-adjustable factor (see zen_pointer_settings), instead
  of a devicetree-fixed ratio like zmk,input-processor-scaler. Intended to sit
  at the end of an existing input-processors chain as an additional,
  user-adjustable multiplier. Takes no reference-site arguments; each instance
  is configured entirely via its own "channel" property.

compatible: "zen,input-processor-live-scale"

include: ip_zero_param.yaml

properties:
  channel:
    type: int
    required: true
    enum:
      - 0
      - 1
    description: |
      0 (pointer channel): REL_X/REL_Y use the pointer scale, invert-x and
      invert-y settings.
      1 (scroll channel): REL_X/REL_Y use the scroll scale and invert-scroll
      settings (for chains where X/Y motion is later remapped to scroll by a
      code-mapper). REL_WHEEL/REL_HWHEEL always use the scroll scale and
      invert-scroll settings, regardless of channel.
```
